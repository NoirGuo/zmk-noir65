## boards/shields/noir65/Kconfig.shield
```kconfig
config SHIELD_NOIR65_LEFT
    def_bool $(shields_list_contains,noir65_left)

config SHIELD_NOIR65_RIGHT
    def_bool $(shields_list_contains,noir65_right)
```
