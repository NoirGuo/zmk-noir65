/*
 * Copyright (c) 2020 Pete Johanson
 *
 * SPDX-License-Identifier: MIT
 */

#include "noir65.dtsi"


&default_transform {
    col-offset = <8>;
};

/ {
    chosen {
        zmk,kscan = &kscan;
    };

    kscan0: kscan {
        compatible = "zmk,kscan-gpio-matrix";
        diode-direction = "col2row";
        wakeup-source;

        row-gpios
            = <&gpio0 31 (GPIO_ACTIVE_HIGH | GPIO_PULL_DOWN)>
            , <&gpio0 29 (GPIO_ACTIVE_HIGH | GPIO_PULL_DOWN)>
            , <&gpio0 2 (GPIO_ACTIVE_HIGH | GPIO_PULL_DOWN)>
            , <&gpio1 15 (GPIO_ACTIVE_HIGH | GPIO_PULL_DOWN)>
            , <&gpio1 13 (GPIO_ACTIVE_HIGH | GPIO_PULL_DOWN)>
        ;
        col-gpios
            = <&gpio0 17 GPIO_ACTIVE_HIGH>
            , <&gpio0 20 GPIO_ACTIVE_HIGH>
            , <&gpio0 22 GPIO_ACTIVE_HIGH>
            , <&gpio0 24 GPIO_ACTIVE_HIGH>
            , <&gpio1 0 GPIO_ACTIVE_HIGH>
            , <&gpio0 11 GPIO_ACTIVE_HIGH>
            , <&gpio1 4 GPIO_ACTIVE_HIGH>
            , <&gpio1 6 GPIO_ACTIVE_HIGH>
        ;
    };
};


